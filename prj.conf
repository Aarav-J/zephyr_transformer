## CMakeLists.txt
```
# SPDX-License-Identifier: Apache-2.0
cmake_minimum_required(VERSION 3.28.0)

find_package(Zephyr REQUIRED HINTS $ENV{ZEPHYR_BASE})
project(zephyr_transformer)

target_sources(app PRIVATE src/main.c)
```

## prj.conf
```kconfig
# Project configuration options for zephyr_transformer.
# See: https://docs.zephyrproject.org/latest/build/kconfig/index.html
```

## src/main.c
```c
/*
 * zephyr_transformer
 *
 * SPDX-License-Identifier: Apache-2.0
 */

#include <stdio.h>
#include <zephyr/kernel.h>

int main(void)
{
	printf("zephyr_transformer booted on %s\n", CONFIG_BOARD_TARGET);

	return 0;
}
```
